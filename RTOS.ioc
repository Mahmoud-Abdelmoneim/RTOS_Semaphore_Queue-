# file: RTOS.ioc
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FREERTOS.BinarySemaphores01=myBinarySem01,Dynamic,NULL
FREERTOS.Tasks01=defaultTask,33,128,Task_1,Default,NULL,Dynamic,NULL,NULL;myTask02,9,128,Task_2,Default,NULL,Dynamic,NULL,NULL
Mcu.Family=STM32F1
Mcu.Name=STM32F103C(8-B)Tx
Mcu.Package=LQFP48
NVIC.PriorityGroup=NVIC_PRIORITYGROUP_4
NVIC.TIM2_IRQn=true\:15\:0\:false\:false\:true\:false\:false\:true\:true
NVIC.TimeBase=TIM2_IRQn
NVIC.TimeBaseIP=TIM2
ProjectManager.HeapSize=0x200
ProjectManager.StackSize=0x400
ProjectManager.TargetToolchain=STM32CubeIDE
RCC.AHBFreq_Value=8000000
RCC.APB1Freq_Value=8000000
RCC.APB1TimFreq_Value=8000000
RCC.APB2Freq_Value=8000000
RCC.APB2TimFreq_Value=8000000
RCC.HCLKFreq_Value=8000000
RCC.SYSCLKFreq_VALUE=8000000
RCC.USBFreq_Value=8000000
VP_FREERTOS_VS_CMSIS_V2.Mode=CMSIS_V2
VP_SYS_VS_tim2.Mode=TIM2
board=custom

// file: Core/Src/main.c
/* USER CODE BEGIN Header */
/**
  ******************************************************************************
  * @file           : main.c
  * @brief          : Main program body
  ******************************************************************************
  * @attention
  *
  * Copyright (c) 2023 STMicroelectronics.
  * All rights reserved.
  *
  * This software is licensed under terms that can be found in the LICENSE file
  * in the root directory of this software component.
  * If no LICENSE file comes with this software, it is provided AS-IS.
  *
  ******************************************************************************
  */
/* USER CODE END Header */
#include "main.h"
#include "cmsis_os.h"

/* USER CODE BEGIN Includes */
#include "GPIO_interface.h"
#include "RCC_interface.h"
#include "LCD_interface.h"
/* USER CODE END Includes */

void SystemClock_Config(void);
void MX_FREERTOS_Init(void);

int main(void)
{

  /* MCU Configuration--------------------------------------------------------*/

  /* Reset of all peripherals, Initializes the Flash interface and the Systick. */
  HAL_Init();

  /* USER CODE BEGIN Init */
	MRCC_voidInit();
	MRCC_voidPeripheralClockEnable(RCC_APB2,GPIO_A);
	LCD_Init();

	uint32_t arr[4]={1,2,3,4};
	uint32_t *pt=arr+1;
	uint32_t *ptr=&arr+1;
	//LCD_Send_String("Without any IDEs");
  /* USER CODE END Init */

  /* Configure the system clock */
  SystemClock_Config();

  /* Initialize all configured peripherals */

  /* Init scheduler */
  osKernelInitialize();  /* Call init function for freertos objects (in freertos.c) */
  MX_FREERTOS_Init();

  /* Start scheduler */
  osKernelStart();
  /* We should never get here as control is now taken by the scheduler */
  /* Infinite loop */
  while (1)
  {

  }
}

void SystemClock_Config(void)
{
  RCC_OscInitTypeDef RCC_OscInitStruct = {0};
  RCC_ClkInitTypeDef RCC_ClkInitStruct = {0};

  /** Initializes the RCC Oscillators according to the specified parameters
  * in the RCC_OscInitTypeDef structure.
  */
  RCC_OscInitStruct.OscillatorType = RCC_OSCILLATORTYPE_HSI;
  RCC_OscInitStruct.HSIState = RCC_HSI_ON;
  RCC_OscInitStruct.HSICalibrationValue = RCC_HSICALIBRATION_DEFAULT;
  RCC_OscInitStruct.PLL.PLLState = RCC_PLL_NONE;
  if (HAL_RCC_OscConfig(&RCC_OscInitStruct) != HAL_OK)
  {
    Error_Handler();
  }

  /** Initializes the CPU, AHB and APB buses clocks
  */
  RCC_ClkInitStruct.ClockType = RCC_CLOCKTYPE_HCLK|RCC_CLOCKTYPE_SYSCLK
                              |RCC_CLOCKTYPE_PCLK1|RCC_CLOCKTYPE_PCLK2;
  RCC_ClkInitStruct.SYSCLKSource = RCC_SYSCLKSOURCE_HSI;
  RCC_ClkInitStruct.AHBCLKDivider = RCC_SYSCLK_DIV1;
  RCC_ClkInitStruct.APB1CLKDivider = RCC_HCLK_DIV1;
  RCC_ClkInitStruct.APB2CLKDivider = RCC_HCLK_DIV1;

  if (HAL_RCC_ClockConfig(&RCC_ClkInitStruct, FLASH_LATENCY_0) != HAL_OK)
  {
    Error_Handler();
  }
}

void HAL_TIM_PeriodElapsedCallback(TIM_HandleTypeDef *htim)
{
  if (htim->Instance == TIM2) {
    HAL_IncTick();
  }
}

void Error_Handler(void)
{
  __disable_irq();
  while (1)
  {
  }
}

// file: Core/Src/freertos.c
/* USER CODE BEGIN Header */
/**
  ******************************************************************************
  * File Name          : freertos.c
  * Description        : Code for freertos applications
  ******************************************************************************
  * @attention
  *
  * Copyright (c) 2023 STMicroelectronics.
  * All rights reserved.
  *
  * This software is licensed under terms that can be found in the LICENSE file
  * in the root directory of this software component.
  * If no LICENSE file comes with this software, it is provided AS-IS.
  *
  ******************************************************************************
  */
/* USER CODE END Header */

#include "FreeRTOS.h"
#include "task.h"
#include "main.h"
#include "cmsis_os.h"

/* USER CODE BEGIN Includes */
#include "LCD_interface.h"
#include "queue.h"
/* USER CODE END Includes */

/* USER CODE BEGIN PTD */
typedef struct{
	uint32_t ID;
	uint8_t name[20];
}student_t;

/* USER CODE END PTD */

/* USER CODE BEGIN Variables */
uint32_t counter=0;

QueueHandle_t  xQueueHandle1;
QueueHandle_t  xQueueHandle2;
/* USER CODE END Variables */
/* Definitions for defaultTask */
osThreadId_t defaultTaskHandle;
const osThreadAttr_t defaultTask_attributes = {
  .name = "defaultTask",
  .stack_size = 128 * 4,
  .priority = (osPriority_t) osPriorityAboveNormal1,
};
/* Definitions for myTask02 */
osThreadId_t myTask02Handle;
const osThreadAttr_t myTask02_attributes = {
  .name = "myTask02",
  .stack_size = 128 * 4,
  .priority = (osPriority_t) osPriorityLow1,
};
/* Definitions for myBinarySem01 */
osSemaphoreId_t myBinarySem01Handle;
const osSemaphoreAttr_t myBinarySem01_attributes = {
  .name = "myBinarySem01"
};

void Task_1(void *argument);
void Task_2(void *argument);

void MX_FREERTOS_Init(void); /* (MISRA C 2004 rule 8.1) */

void MX_FREERTOS_Init(void) {

  /* Create the semaphores(s) */
  /* creation of myBinarySem01 */
  myBinarySem01Handle = osSemaphoreNew(1, 1, &myBinarySem01_attributes);

  /* USER CODE BEGIN RTOS_QUEUES */
  /* add queues, ... */
  xQueueHandle1 = xQueueCreate(10, sizeof(uint32_t));
  /* USER CODE END RTOS_QUEUES */

  /* Create the thread(s) */
  /* creation of defaultTask */
  defaultTaskHandle = osThreadNew(Task_1, NULL, &defaultTask_attributes);

  /* creation of myTask02 */
  myTask02Handle = osThreadNew(Task_2, NULL, &myTask02_attributes);

}

void Task_1(void *argument)
{
  /* USER CODE BEGIN Task_1 */
	BaseType_t RetVal=pdTRUE;
	uint8_t count=0;
  /* Infinite loop */
  for(;;)
  {

	  RetVal = xQueueSendToFront(xQueueHandle1,(void *)&count,1000);
	  if(RetVal == pdTRUE)
	  {
	      //osSemaphoreAcquire(myBinarySem01Handle, 4000);
		  //LCD_Send_Command(_LCD_CLEAR);
		  LCD_Send_String_Pos("sending succeeded",1,1);
		  osSemaphoreRelease(myBinarySem01Handle);
	  }
	  else{
		  LCD_Send_Command(_LCD_CLEAR);
		  HAL_Delay(100);
		  LCD_Send_String("send failed ");
		  HAL_Delay(100);
	  }
   	  count++;
	  osDelay(1500);

  }
  /* USER CODE END Task_1 */
}

void Task_2(void *argument)
{
  /* USER CODE BEGIN Task_2 */
	BaseType_t RetVal=pdTRUE;
	uint8_t count=0;
  /* Infinite loop */

  for(;;)
  {
	  RetVal= xQueueReceive(xQueueHandle1, &count, portMAX_DELAY);
	  if(pdTRUE == RetVal)
	  {
		  osSemaphoreAcquire(myBinarySem01Handle, 4000);
		  LCD_Send_String_Pos("message Rece=",2,1);
		  LCD_Send_Number_Pos(count, 2, 14);
		  osSemaphoreRelease(myBinarySem01Handle);
	  }
	  else{
		  LCD_Send_Command(_LCD_CLEAR);
		  HAL_Delay(100);
		  LCD_Send_String("queue not Rec ");
		  HAL_Delay(100);
	  }
	    //osDelay(1000);
  }
  /* USER CODE END Task_2 */
}
